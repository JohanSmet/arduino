/* test_6502_memory - use an Arduino as a "replacement" for a 6502 processor in order to test access to system memory
 *
 * Developped to help me repair a Tetris bootleg arcade board that was being difficult.
 *   - ignores the input clock and drives phi2 - phi1 was not used on the arcade board
 *	 - writes / reads memory and stops when error to allow easy tracing with a logic probe
 *
 * Copyright (c) 2019 - Johan Smet - Licensed under the BSD-3-CLAUSE license (reproduced below)

 * Redistribution and use in source and binary forms, with or without modification,
 * are permitted provided that the following conditions are met:
 * 1. Redistributions of source code must retain the above copyright notice,
 *    this list of conditions and the following disclaimer.
 * 2. Redistributions in binary form must reproduce the above copyright notice,
 *    this list of conditions and the following disclaimer in the documentation
 *    and/or other materials provided with the distribution.
 * 3. Neither the name of the copyright holder nor the names of its contributors
 *    may be used to endorse or promote products derived from this software
 *    without specific prior written permission.
 *
 * THIS SOFTWARE IS PROVIDED BY THE COPYRIGHT HOLDERS AND CONTRIBUTORS "AS IS" AND
 * ANY EXPRESS OR IMPLIED WARRANTIES, INCLUDING, BUT NOT LIMITED TO, THE IMPLIED
 * WARRANTIES OF MERCHANTABILITY AND FITNESS FOR A PARTICULAR PURPOSE ARE DISCLAIMED.
 * IN NO EVENT SHALL THE COPYRIGHT HOLDER OR CONTRIBUTORS BE LIABLE FOR ANY DIRECT,
 * INDIRECT, INCIDENTAL, SPECIAL, EXEMPLARY, OR CONSEQUENTIAL DAMAGES (INCLUDING,
 * BUT NOT LIMITED TO, PROCUREMENT OF SUBSTITUTE GOODS OR SERVICES; LOSS OF USE,
 * DATA, OR PROFITS; OR BUSINESS INTERRUPTION) HOWEVER CAUSED AND ON ANY THEORY OF
 * LIABILITY, WHETHER IN CONTRACT, STRICT LIABILITY, OR TORT (INCLUDING NEGLIGENCE
 * OR OTHERWISE) ARISING IN ANY WAY OUT OF THE USE OF THIS SOFTWARE, EVEN IF ADVISED
 * OF THE POSSIBILITY OF SUCH DAMAGE.
 */


/* pin definitions */
const int PIN_6502_RDY = 22;
const int PIN_6502_PH1 = 23;
const int PIN_6502_IRQ = 24;
const int PIN_6502_RES = 25;
const int PIN_6502_NMI = 26;
const int PIN_6502_PH2 = 27;
const int PIN_6502_SYN = 28;
const int PIN_6502_RW  = 29;

const int PIN_6502_AB0 = 30;
const int PIN_6502_AB1 = 31;
const int PIN_6502_AB2 = 32;
const int PIN_6502_AB3 = 33;
const int PIN_6502_AB4 = 34;
const int PIN_6502_AB5 = 35;
const int PIN_6502_AB6 = 36;
const int PIN_6502_AB7 = 37;
const int PIN_6502_AB8 = 38;
const int PIN_6502_AB9 = 39;
const int PIN_6502_AB10 = 40;
const int PIN_6502_AB11 = 41;
const int PIN_6502_AB12 = 42;
const int PIN_6502_AB13 = 43;
const int PIN_6502_AB14 = 44;
const int PIN_6502_AB15 = 45;

const int PIN_6502_DB7 = 46;
const int PIN_6502_DB6 = 47;
const int PIN_6502_DB5 = 48;
const int PIN_6502_DB4 = 49;
const int PIN_6502_DB3 = 50;
const int PIN_6502_DB2 = 51;
const int PIN_6502_DB1 = 52;
const int PIN_6502_DB0 = 53;

const int PIN_CONTINUE = 2;
const int PIN_CHECKPOINT = A7;
const int PIN_TEST_RAM = A6;
const int PIN_TEST_ROM = A5;
const int PIN_TEST_DISPLAY = A4;

const int RW_READ = HIGH;
const int RW_WRITE = LOW;

/* pallette data for the Tetris bootleg board */
const byte PALLETE_DATA[] = {
	0x00,0x6d,0xff,0x00,0x04,0x08,0x0c,0x10,0x14,0x18,0x1c,0xff,0xff,0xff,0xff,0xff,
	0xb6,0x49,0x00,0x00,0x80,0xa0,0xc0,0xe0,0x00,0x04,0x08,0x0c,0x10,0x14,0x18,0x1c,
	0x00,0x00,0x00,0x00,0x49,0x49,0x49,0x49,0x92,0x92,0x92,0x92,0xdb,0xdb,0xdb,0xdb,
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	0xd6,0x02,0x00,0x00,0x00,0x00,0x00,0x00,0x00,0x00,0x00,0x00,0x00,0x00,0x00,0x00
};

/* test display data for the Tetris bootleg board */
const byte DISPLAY_DATA[] = {
  0x00, 0x00, 0x00, 0x00, 0x00, 0x00, 0x00, 0x00, 0x00, 0x00, 0x00, 0x00,
  0x00, 0x00, 0x00, 0x00, 0x00, 0x00, 0x00, 0x00, 0x00, 0x00, 0x00, 0x00,
  0x00, 0x00, 0x00, 0x00, 0x00, 0x00, 0x00, 0x00, 0x00, 0x00, 0x00, 0x00,
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  0x00, 0x00, 0x00, 0x00
};

/* test configuration: change to configure which area of memory to test
	0x0000 - 0x0fff : program RAM
	0x1000 - 0x1fff : playfield RAM
	0x2000 - 0x20ff : color RAM
	0x4000 - 0x7fff : paged program ROM
	0x8000 - 0xffff : fixed program ROM
*/
const int ADDRESS_MIN = 0x0000;
const int ADDRESS_MAX = 0x20ff;

/* global data */
bool g_clock = LOW;
bool g_sync  = LOW;
bool g_rw    = RW_READ;

uint8_t  g_data_bus = 0;
uint16_t g_address_bus = 0;

bool g_checkpoint_enable = false;
bool g_test_ram = false;
bool g_test_rom = false;
bool g_test_display = false;

volatile byte g_continue = false;

/* utility functions */
void data_mode_input() {
	pinMode(PIN_6502_DB0, INPUT);
	pinMode(PIN_6502_DB1, INPUT);
	pinMode(PIN_6502_DB2, INPUT);
	pinMode(PIN_6502_DB3, INPUT);
	pinMode(PIN_6502_DB4, INPUT);
	pinMode(PIN_6502_DB5, INPUT);
	pinMode(PIN_6502_DB6, INPUT);
	pinMode(PIN_6502_DB7, INPUT);
}

void data_mode_output() {
	pinMode(PIN_6502_DB0, OUTPUT);
	pinMode(PIN_6502_DB1, OUTPUT);
	pinMode(PIN_6502_DB2, OUTPUT);
	pinMode(PIN_6502_DB3, OUTPUT);
	pinMode(PIN_6502_DB4, OUTPUT);
	pinMode(PIN_6502_DB5, OUTPUT);
	pinMode(PIN_6502_DB6, OUTPUT);
	pinMode(PIN_6502_DB7, OUTPUT);
}

void set_read_write_mode(int mode) {
	g_rw = mode;

	if (mode == RW_READ) {
		data_mode_input();
	} else {
		data_mode_output();
	}
}

void output_signals() {
	digitalWrite(PIN_6502_PH1, !g_clock);
	digitalWrite(PIN_6502_PH2, g_clock);
	digitalWrite(PIN_6502_SYN, g_sync);
	digitalWrite(PIN_6502_RW,  g_rw);

	if (!g_rw) {
		digitalWrite(PIN_6502_DB0, (g_data_bus >> 0) & 0x01);
		digitalWrite(PIN_6502_DB1, (g_data_bus >> 1) & 0x01);
		digitalWrite(PIN_6502_DB2, (g_data_bus >> 2) & 0x01);
		digitalWrite(PIN_6502_DB3, (g_data_bus >> 3) & 0x01);
		digitalWrite(PIN_6502_DB4, (g_data_bus >> 4) & 0x01);
		digitalWrite(PIN_6502_DB5, (g_data_bus >> 5) & 0x01);
		digitalWrite(PIN_6502_DB6, (g_data_bus >> 6) & 0x01);
		digitalWrite(PIN_6502_DB7, (g_data_bus >> 7) & 0x01);
	}

	digitalWrite(PIN_6502_AB0, (g_address_bus >> 0) & 0x01);
	digitalWrite(PIN_6502_AB1, (g_address_bus >> 1) & 0x01);
	digitalWrite(PIN_6502_AB2, (g_address_bus >> 2) & 0x01);
	digitalWrite(PIN_6502_AB3, (g_address_bus >> 3) & 0x01);
	digitalWrite(PIN_6502_AB4, (g_address_bus >> 4) & 0x01);
	digitalWrite(PIN_6502_AB5, (g_address_bus >> 5) & 0x01);
	digitalWrite(PIN_6502_AB6, (g_address_bus >> 6) & 0x01);
	digitalWrite(PIN_6502_AB7, (g_address_bus >> 7) & 0x01);
	digitalWrite(PIN_6502_AB8, (g_address_bus >> 8) & 0x01);
	digitalWrite(PIN_6502_AB9, (g_address_bus >> 9) & 0x01);
	digitalWrite(PIN_6502_AB10, (g_address_bus >> 10) & 0x01);
	digitalWrite(PIN_6502_AB11, (g_address_bus >> 11) & 0x01);
	digitalWrite(PIN_6502_AB12, (g_address_bus >> 12) & 0x01);
	digitalWrite(PIN_6502_AB13, (g_address_bus >> 13) & 0x01);
	digitalWrite(PIN_6502_AB14, (g_address_bus >> 14) & 0x01);
	digitalWrite(PIN_6502_AB15, (g_address_bus >> 15) & 0x01);

	delayMicroseconds(1);
}

uint8_t read_databus() {
	uint8_t result = (digitalRead(PIN_6502_DB0) << 0) |
					 (digitalRead(PIN_6502_DB1) << 1) |
					 (digitalRead(PIN_6502_DB2) << 2) |
					 (digitalRead(PIN_6502_DB3) << 3) |
					 (digitalRead(PIN_6502_DB4) << 4) |
					 (digitalRead(PIN_6502_DB5) << 5) |
					 (digitalRead(PIN_6502_DB6) << 6) |
					 (digitalRead(PIN_6502_DB7) << 7);
	return result;
}

void checkpoint(const char *message) {
  if (g_checkpoint_enable) {
  	Serial1.print("Checkpoint ");
  	Serial1.println(message);

  	while (!g_continue)
  		delay(10);

  	g_continue = false;
  }
}

void write_byte(uint16_t address, uint8_t data) {

	// make sure we start on a negative going clock transition
	if (!g_clock) {
		g_clock = true;
		output_signals();
	}

	// negative going edge (ref "A")
	g_clock = false;
	set_read_write_mode(RW_WRITE);
	g_address_bus = address;
	output_signals();
	checkpoint("WRITE-1");

	// positive going edge (ref "B")
	g_clock = true;
	g_data_bus = data;

	output_signals();
	checkpoint("WRITE-2");

	// negative going edge (ref "C")
	g_clock = false;
	g_rw = RW_READ;
	output_signals();

	set_read_write_mode(RW_READ);
}

uint8_t read_byte(uint16_t address) {

	// make sure we start on a negative going clock transition
	if (!g_clock) {
		g_clock = true;
		output_signals();
	}

	// negative going edge (ref "A")
	g_clock = false;
	set_read_write_mode(RW_READ);
	g_address_bus = address;
	output_signals();
	checkpoint("READ-1");

	// positive going edge (ref "B")
	g_clock = true;
	output_signals();
	checkpoint("READ-2");

	return read_databus();
}

void continue_isr() {
	static unsigned long last_isr_time = 0;

	unsigned long time = millis();

	if (time - last_isr_time > 200) {
		g_continue = true;
		last_isr_time = time;
	}
}

void read_dip_switches() {
  g_checkpoint_enable = digitalRead(PIN_CHECKPOINT) == LOW;
  g_test_ram          = digitalRead(PIN_TEST_RAM) == LOW;
  g_test_rom          = digitalRead(PIN_TEST_ROM) == LOW;
  g_test_display      = digitalRead(PIN_TEST_DISPLAY) == LOW;
}

uint16_t proc_address = ADDRESS_MIN;
bool proc_error = false;

/* test routine for RAM - writes a value and reads it back */
void process_ram() {
	digitalWrite(LED_BUILTIN, proc_error);
	if (proc_error || proc_address > ADDRESS_MAX) {
		return;
	}

	Serial1.print("Testing address 0x");
	Serial1.println(proc_address, HEX);

	write_byte(proc_address, 0x55);
	uint8_t read_1 = read_byte(proc_address);
	if (read_1 != 0x55) {
		Serial1.print("Error at address 0x");
		Serial1.print(proc_address, HEX);
		Serial1.print(" wrote 0x55 - read ");
		Serial1.println(read_1, HEX);
		proc_error = true;
		return;
	}

	write_byte(proc_address, 0xaa);
	uint8_t read_2 = read_byte(proc_address);
	if (read_2 != 0xaa) {
		Serial1.print("Error at address 0x");
		Serial1.print(proc_address, HEX);
		Serial1.print(" wrote 0xaa - read ");
		Serial1.println(read_2, HEX);
		proc_error = true;
		return;
	}

	proc_address++;
}

/* test routine for rom - read and display */
void process_rom() {

	digitalWrite(LED_BUILTIN, proc_error);
	if (proc_error || proc_address > ADDRESS_MAX) {
		return;
	}

	byte data = read_byte(proc_address);

	Serial1.print(data, HEX);
	Serial1.print(" ");

	proc_address++;
	if (proc_address > ADDRESS_MAX) {
		Serial1.println();
	}
}

/* test routine that tries to output something to the display of the tetris bootleg board */
void process_display() {
	/* pallette */
	for (int i = 0; i < sizeof(PALLETE_DATA); ++i) {
		write_byte(0x2000 + i, PALLETE_DATA[i]);
	}

	for (int i = 0; i < sizeof(DISPLAY_DATA); ++i) {
		write_byte(0x1000 + i, DISPLAY_DATA[i]);
	}
}

/* device setup */
void setup() {
	/* enable serial I/O with host computer */
  Serial1.begin(9600);

	/* pin mode - control signals */
	pinMode(PIN_6502_RDY, INPUT);		// IN - enable/disable cpu
	pinMode(PIN_6502_PH1, OUTPUT);		// OUT - clock phase 1
	pinMode(PIN_6502_IRQ, INPUT);		// IN - /IRQ
	pinMode(PIN_6502_RES, INPUT);		// IN - /RES
	pinMode(PIN_6502_NMI, INPUT);		// IN - /NMI
	pinMode(PIN_6502_PH2, OUTPUT);		// OUT - clock phase 2
	pinMode(PIN_6502_SYN, OUTPUT);		// OUT - signals start of instruction
	pinMode(PIN_6502_RW,  OUTPUT);		// OUT - read/write

	/* pin mode - address lines */
	for (int pin = PIN_6502_AB0; pin <= PIN_6502_AB15; ++pin) {
		pinMode(pin, OUTPUT);
	}

	/* pin mode - data lines */
	data_mode_output();

	/* use builtin-led to visualize clock phase 2 */
	pinMode(LED_BUILTIN, OUTPUT);

  /* dip-switches */
  pinMode(PIN_CHECKPOINT, INPUT_PULLUP);
  pinMode(PIN_TEST_RAM, INPUT_PULLUP);
  pinMode(PIN_TEST_ROM, INPUT_PULLUP);
  pinMode(PIN_TEST_DISPLAY, INPUT_PULLUP);

	/* push-button to continue from checkpoints */
	pinMode(PIN_CONTINUE, INPUT_PULLUP);
	attachInterrupt(digitalPinToInterrupt(PIN_CONTINUE), continue_isr, FALLING);

  /* settings and test selection */
  read_dip_switches();
  Serial1.println(g_checkpoint_enable ? "Checkpoints  = enabled" : "Checkpoints  = disabled");
  Serial1.println(g_test_ram ?          "RAM test     = enabled" : "RAM test     = disabled");
  Serial1.println(g_test_rom ?          "ROM test     = enabled" : "ROM test     = disabled");
  Serial1.println(g_test_display ?      "Display test = enabled" : "Display test = disabled");

	delay(5000);
 	Serial1.println("setup complete");
}

/* main loop */
void loop() {
	bool reset = digitalRead(PIN_6502_RES);

	if (reset == LOW) {
		g_clock = LOW;
		g_sync = LOW;
		set_read_write_mode(RW_READ);
		g_data_bus = 0;
		g_address_bus = 0;
		output_signals();
	} else {
    if (g_test_ram) {
		  process_ram();
    }
    if (g_test_rom) {
		  process_rom();
    }
    if (g_test_display) {
		  process_display();
    }
	}
}
